## conf/distro/include/tb-distro.inc
```bitbake
require conf/distro/poky.conf

DISTRO_NAME = "Reference Yocto distro for PC Engines hardware"
DISTRO_VERSION = "0.1"
SDK_VENDOR = "-tbsdk"
TARGET_VENDOR = "-tb"

MAINTAINER = "maciej.pijanowski@3mdeb.com"

DISTRO_FEATURES = " \
    ext2 \
    keyboard \
    largefile \
    ldconfig \
    nfs \
    pci \
    systemd \
    usbgadget \
    usbhost \
    tpm2 \
"

# disable sysvinit
VIRTUAL-RUNTIME_init_manager = "systemd"
VIRTUAL-RUNTIME_initscripts = ""
VIRTUAL-RUNTIME_syslog = ""
DISTRO_FEATURES_BACKFILL_CONSIDERED += "sysvinit"

PREFERRED_PROVIDER_virtual/kernel = "linux-tb"
PREFERRED_VERSION_linux-tb ?= "5.5%"
```

## conf/distro/tb-base.conf
```bitbake
require conf/distro/include/tb-distro.inc

DISTRO = "tb-base"
DISTROOVERRIDES = "tb:tb-base"
```

## conf/distro/tb-distro.conf
```bitbake
require conf/distro/include/tb-distro-common.conf

DISTRO = "tb-distro"
TB_GRUB_CFG_FILE = "grub-minimal.cfg"
```

## conf/distro/tb-efi.conf
```bitbake
require conf/distro/include/tb-distro.inc

INITRAMFS_IMAGE = "core-image-minimal-initramfs"
INITRAMFS_IMAGE_BUNDLE = "1"

DISTRO = "tb-efi"
DISTROOVERRIDES = "tb:tb-efi"
DISTRO_FEATURES_append = " virtualization"
```

## conf/distro/tb-xen-distro.conf
```bitbake
require conf/distro/include/tb-distro-common.conf

DISTRO = "tb-xen-distro"
DISTRO_FEATURES += "virtualization xen"

IMAGE_EFI_BOOT_FILES += " \
    xen-${MACHINE};xen \
"

PREFERRED_VERSION_xen = "4.17+tb"
# TODO: for some reason, building tools from TB fork does not build all of the
# tools - many basic binaries are missing
PREFERRED_VERSION_xen-tools = "4.17+stable"
```

## conf/distro/tb-xen.conf
```bitbake
require conf/distro/include/tb-distro.inc

DISTRO = "tb-xen"
DISTROOVERRIDES = "tb:tb-xen"
DISTRO_FEATURES:append = " virtualization xen"
```

## conf/layer.conf
```bitbake
# We have a conf and classes directory, add to BBPATH
BBPATH .= ":${LAYERDIR}"

BBFILES += " \
    ${LAYERDIR}/recipes-*/*/*.bb \
    ${LAYERDIR}/recipes-*/*/*.bbappend \
"

BBFILE_COLLECTIONS += "meta-trenchboot"
BBFILE_PATTERN_meta-trenchboot = "^${LAYERDIR}/"
BBFILE_PRIORITY_meta-trenchboot = "6"

LAYERDEPENDS_meta-trenchboot = "core openembedded-layer"
LAYERSERIES_COMPAT_meta-trenchboot = "scarthgap"
```

## wic/trenchboot-efi-image.wks
```
part /boot  --source bootimg-efi --sourceparams="loader=grub-efi" --ondisk sda --label msdos --active --align 1024
part /      --source rootfs --ondisk sda --fstype=ext4 --label rootfsA --align 4096 --fixed-size 2048
bootloader  --ptable msdos --timeout=5 --append="rootfstype=ext4 console=ttyS0,115200 earlyprintk=serial,ttyS0,115200"
```

## wic/trenchboot-image-efipluslegacy.wks
```
bootloader --timeout=0 --append=" rootwait"

part /boot --source bootimg-biosplusefi-tb --sourceparams="loader=grub-efi" --ondisk sda --label boot --align 1024 --use-uuid --active --system-id 0xef
part /     --source rootfs --fstype=ext4                                 --ondisk sda --label root --align 1024 --use-uuid --fixed-size 1024
```

## wic/trenchboot-image.wks
```
part /boot  --source bootimg-grub-tb  --ondisk sda --label msdos1 --active --align 1024
part /      --source rootfs --ondisk sda --fstype=ext4 --label rootfsA1 --align 4096 --fixed-size 2048
bootloader  --ptable msdos --timeout=5 --append="rootfstype=ext4 console=ttyS0,115200 earlyprintk=serial,ttyS0,115200"
```
